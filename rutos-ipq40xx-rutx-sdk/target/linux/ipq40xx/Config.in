## rutos-ipq40xx-rutx-sdk/target/linux/ipq40xx/Config.in
```kconfig
menu "Target options and settings"
depends on TARGET_ipq40xx

config DEFAULT_TARGET_OPTIONS
	bool
	default y
	select KERNEL_MTD_UBI
	select KERNEL_MTD_UBI_BLOCK
	select PACKAGE_crconf
	select PACKAGE_kmod-crypto-user

endmenu
```

## target/linux/generic/files/drivers/sysfs-mnfinfo/Kconfig
```kconfig
config SYSFS_MNFINFO
	bool "Mnfinfo via sysfs"
	default y
	help
	  This provides a ability to read device RO metadata via sysfs.
```
